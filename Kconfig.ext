## drivers/input/misc/anc_fps_mmi/Kconfig
```kconfig
# SPDX-License-Identifier: GPL-2.0-only

config ANC_FPS_MMI
	tristate "ANC fingerprint sensor driver (MMI)"
	help
	  ANC fingerprint sensor driver for Motorola devices
	  with MMI extensions.
```

## drivers/input/misc/goodix_fod_mmi/Kconfig
```kconfig
# SPDX-License-Identifier: GPL-2.0-only

config GOODIX_FOD_MMI
	tristate "Goodix fingerprint on display driver (MMI)"
	help
	  Goodix fingerprint on display (FOD) driver for
	  Motorola devices.
```

## drivers/input/touchscreen/goodix_berlin_mmi/Kconfig
```kconfig
# SPDX-License-Identifier: GPL-2.0-only

config TOUCHSCREEN_GOODIX_BERLIN_MMI
	tristate "Goodix Berlin touchscreen driver (MMI)"
	help
	  Goodix Berlin series touchscreen driver for Motorola
	  devices with MMI extensions.
```

## drivers/input/touchscreen/touchscreen_mmi/Kconfig
```kconfig
# SPDX-License-Identifier: GPL-2.0-only

config TOUCHSCREEN_MMI
	tristate "Motorola touchscreen MMI framework"
	help
	  Motorola touchscreen MMI framework providing common
	  interface for touchscreen drivers.
```

## drivers/misc/awinic/sarsensor/Kconfig
```kconfig
# SPDX-License-Identifier: GPL-2.0-only

config AWINIC_SAR
	tristate "Awinic SAR sensor driver"
	help
	  Awinic SAR (Specific Absorption Rate) proximity
	  sensor driver for Motorola devices.
```

## drivers/misc/mmi_sys_temp/Kconfig
```kconfig
# SPDX-License-Identifier: GPL-2.0-only

config MMI_SYS_TEMP
	tristate "Motorola system temperature driver"
	help
	  Motorola system temperature driver for thermal
	  zone monitoring via sysfs.
```

## drivers/misc/sx937x/Kconfig
```kconfig
# SPDX-License-Identifier: GPL-2.0-only

config SX937X_SAR
	tristate "Semtech SX937x SAR sensor driver"
	help
	  Semtech SX937x SAR (Specific Absorption Rate) proximity
	  sensor driver for Motorola devices.
```

## drivers/misc/utag/Kconfig
```kconfig
# SPDX-License-Identifier: GPL-2.0-only

config UTAG
	tristate "Motorola utag driver"
	help
	  Motorola utag (user tag) driver for persistent
	  storage of device configuration tags.
```

## drivers/mmi_annotate/Kconfig
```kconfig
# SPDX-License-Identifier: GPL-2.0-only

config MMI_ANNOTATE
	tristate "Motorola MMI annotate support"
	help
	  Motorola MMI annotate driver for debug annotations
	  in kernel log via sysfs.
```

## drivers/mmi_info/Kconfig
```kconfig
# SPDX-License-Identifier: GPL-2.0-only

config MMI_INFO
	tristate "Motorola MMI device info driver"
	help
	  Motorola MMI device info driver exposing hardware
	  revision and product information via sysfs.
```

## drivers/mmi_relay/Kconfig
```kconfig
# SPDX-License-Identifier: GPL-2.0-only

config MMI_RELAY
	tristate "Motorola MMI relay driver"
	help
	  Motorola MMI relay driver for userspace-kernel
	  communication channel.
```

## drivers/moto_con_dfpar/Kconfig
```kconfig
# SPDX-License-Identifier: GPL-2.0-only

config MOTO_CON_DFPAR
	tristate "Motorola console dfpar driver"
	help
	  Motorola console driver for diagnostic framebuffer
	  parallel output.
```

## drivers/moto_f_usbnet/Kconfig
```kconfig
# SPDX-License-Identifier: GPL-2.0-only

config MOTO_F_USBNET
	tristate "Motorola USB networking driver"
	help
	  Motorola USB networking function driver for
	  fastboot and diagnostic interfaces.
```

## drivers/moto_mm/Kconfig
```kconfig
# SPDX-License-Identifier: GPL-2.0-only

config MOTO_MM
	tristate "Motorola memory management driver"
	help
	  Motorola memory management driver for vendor-specific
	  memory operations.
```

## drivers/moto_mmap_fault/Kconfig
```kconfig
# SPDX-License-Identifier: GPL-2.0-only

config MOTO_MMAP_FAULT
	tristate "Motorola mmap fault handler"
	help
	  Motorola custom mmap fault handler for vendor-specific
	  memory mapping operations.
```

## drivers/nfc/mmi_nfc_clk/Kconfig
```kconfig
# SPDX-License-Identifier: GPL-2.0-only

config MMI_NFC_CLK
	tristate "Motorola NFC clock driver"
	help
	  Motorola NFC clock driver for NFC controller
	  clock management.
```

## drivers/power/mmi-smbcharger-iio/Kconfig
```kconfig
# SPDX-License-Identifier: GPL-2.0-only

config MMI_SMBCHARGER_IIO
	tristate "Motorola SMB charger IIO driver"
	help
	  Motorola SMB charger IIO driver for Qualcomm SMB
	  charger monitoring via IIO subsystem.
```

## drivers/power/mmi_charger/Kconfig
```kconfig
# SPDX-License-Identifier: GPL-2.0-only

config MMI_CHARGER
	tristate "Motorola MMI charger driver"
	help
	  Motorola MMI charger driver for battery charging
	  management and status reporting.
```

## drivers/power/mmi_parallel_charger_iio/Kconfig
```kconfig
# SPDX-License-Identifier: GPL-2.0-only

config MMI_PARALLEL_CHARGER_IIO
	tristate "Motorola parallel charger IIO driver"
	help
	  Motorola parallel charger IIO driver for multi-path
	  charging current monitoring.
```

## drivers/power/mmi_sc8541_iio/Kconfig
```kconfig
# SPDX-License-Identifier: GPL-2.0-only

config MMI_SC8541_IIO
	tristate "Motorola SC8541 IIO charger driver"
	help
	  Motorola SC8541 IIO driver for SC8541 bidirectional
	  charge pump controller.
```

## drivers/power/qpnp_adaptive_charge/Kconfig
```kconfig
# SPDX-License-Identifier: GPL-2.0-only

config QPNP_ADAPTIVE_CHARGE
	tristate "Qualcomm PMIC adaptive charging driver"
	help
	  Qualcomm PMIC adaptive charging driver for intelligent
	  charge rate optimization.
```

## drivers/power/wakeup_sources/Kconfig
```kconfig
# SPDX-License-Identifier: GPL-2.0-only

config WAKEUP_SOURCES
	tristate "Motorola wakeup sources driver"
	help
	  Motorola wakeup sources driver for managing
	  wakeup irq sources.
```

## drivers/sensors/Kconfig
```kconfig
# SPDX-License-Identifier: GPL-2.0-only

config SENSORS_CLASS
	tristate "Motorola sensors class driver"
	help
	  Motorola sensors class driver providing sysfs interface
	  for sensor management.
```

## drivers/watchdogtest/Kconfig
```kconfig
# SPDX-License-Identifier: GPL-2.0-only

config WATCHDOGTEST
	tristate "Motorola watchdog test driver"
	help
	  Motorola watchdog timer test driver for hardware
	  watchdog verification.
```
